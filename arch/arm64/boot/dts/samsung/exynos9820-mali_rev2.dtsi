/*
 * SAMSUNG EXYNOS7885 SoC device tree source
 *
 * Copyright (c) 2018 Samsung Electronics Co., Ltd.
 *		http://www.samsung.com
 *
 * This program is free software; you can redistribute it and/or modify
 * it under the terms of the GNU General Public License version 2 as
 * published by the Free Software Foundation.
*/

&mali {
	interactive_info = <260000 94 0>;
	gpu_dvfs_table_size = <9 8>; /*<row col>*/
	/*  8 columns       freq      down up stay  mif    little    middle   big  */
	gpu_dvfs_table = <  754000     90  95  1   2093000       0       0       0
	                    650000     80  90  1   2093000       0       0       0
	                    572000     70  80  1   1794000       0       0       0
	                    433000     60  70  1   1352000       0       0       0
	                    377000     50  60  1   1352000       0       0       0
	                    325000     40  50  1   1014000       0       0       0
	                    260000     30  40  1    676000       0       0       0
	                    200000     20  30  1    676000       0       0       0
	                    156000     0   0   1    676000       0       0       0 >;
	gpu_max_clock = <754000>;
	gpu_max_clock_limit = <754000>;
	gpu_min_clock = <156000>;
	gpu_dvfs_start_clock = <156000>;
	gpu_dvfs_bl_config_clock = <156000>;
};
